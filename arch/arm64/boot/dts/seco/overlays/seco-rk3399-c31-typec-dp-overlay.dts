/*
 * Copyright 2020 SECO
 *
 * This program is free software; you can redistribute it and/or
 * modify it under the terms of the GNU General Public License
 * as published by the Free Software Foundation; either version 2
 * of the License, or (at your option) any later version.
 *
 * This program is distributed in the hope that it will be useful,
 * but WITHOUT ANY WARRANTY; without even the implied warranty of
 * MERCHANTABILITY or FITNESS FOR A PARTICULAR PURPOSE.  See the
 * GNU General Public License for more details.
 */

/dts-v1/;
/plugin/;

/ {
	compatible = "rockchip,seco-rk3399-c31", "rockchip,rk3399";  

/*  __________________________________________________________________________
 * |                                                                          |
 * |                               DP on TypeC	                              |
 * |__________________________________________________________________________|
 */


    	fragment@0 {
        	target = <&cdn_dp>;
        	__overlay__ {
			status = "okay";
		};
	};

    	fragment@1 {
        	target = <&dp_in_vopb>;
        	__overlay__ {
			status = "okay";
		};
	};

    	fragment@2 {
        	target = <&dp_in_vopl>;
        	__overlay__ {
			status = "okay";
		};
	};
};

